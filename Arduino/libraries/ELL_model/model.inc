
---------------------------------------------------------------------- */


static const neuton_weight_t MODEL_WEIGHTS[] = { -0.253413141, -0.370900154,
     0.710116148, 0.832789063, -0.955095768, -0.617428303, -0.148556441, -1,
     0.125319839, 0.670520127, -0.694222987, -0.786903501, -0.429822803, 0.666100562,
     0.289408803 };

static const neuton_sources_num_t MODEL_LINKS[] = { 0, 1, 2, 0, 0, 1, 2, 1, 0,
     1, 2, 0, 1, 2, 2 };

static const neuton_weights_num_t MODEL_INTERNAL_LINKS_BOUNDARIES[] = { 0, 4,
     8, 14 };

static const neuton_weights_num_t MODEL_EXTERNAL_LINKS_BOUNDARIES[] = { 3, 7,
     11, 15 };

static const neuton_coeff_t MODEL_ACTIVATION_COEFFS[] = { 20, 9.03165722, 9.03165722,
     9.03165722 };

static const neuton_u8_t MODEL_ACTIVATION_TYPE_MASK[] = { 0x07 };

static const neuton_neurons_num_t MODEL_OUTPUT_NEURONS[] = { 3 };

static const neuton_output_t MODEL_OUTPUT_SCALE_MIN[] = { -2.9000001 };
static const neuton_output_t MODEL_OUTPUT_SCALE_MAX[] = { 33.7000008 };

